## main/Kconfig.projbuild
```kconfig
menu "PRINTMASS Config"

  config PRNM_DEVMODE
    bool "Dev Mode"
    default n
  
  menu "PRINTER"
    config PRNM_PRINTER_BDA
      string "Remote printer BLE device address (AA:BB:CC:DD:EE:FF)"
      default "06:01:06:FB:2A:31"

    config PRNM_BT_MTU
      int "BT MTU"
      default 200

    config PRNM_PRINTER_PING_MS
      int "Ping printer every N ms"
      default 600000

  endmenu

  menu "TOUCH"

    config PRNM_TOUCH_GPIO
      int "Touch sensor GPIO input"
      default 12

    config PRNM_TOUCH_DEBOUNCE
      int "Touch sensor debounce"
      default 100

  endmenu

  menu "LEDs"

    config PRNM_LED_1_GPIO
      int "Led tree gpio"
      default 7

    config PRNM_LED_2_GPIO
      int "Led tree gpio"
      default 8

    config PRNM_LED_3_GPIO
      int "Led tree gpio"
      default 9

    config PRNM_LED_4_GPIO
      int "Led tree gpio"
      default 4

    config PRNM_LED_5_GPIO
      int "Led tree gpio"
      default 5

    config PRNM_LED_6_GPIO
      int "Led tree gpio"
      default 6

  endmenu

endmenu
```

## sdkconfig.defaults
```kconfig
CONFIG_IDF_TARGET="esp32s3"

CONFIG_ESPTOOLPY_FLASHMODE_DIO=y
CONFIG_ESPTOOLPY_FLASHMODE="dio"
CONFIG_ESPTOOLPY_FLASHFREQ_80M=y
CONFIG_ESPTOOLPY_FLASHFREQ="80m"
CONFIG_ESPTOOLPY_FLASHSIZE_4MB=y
CONFIG_ESPTOOLPY_FLASHSIZE="4MB"

CONFIG_PARTITION_TABLE_SINGLE_APP_LARGE=y

CONFIG_BT_ENABLED=y
CONFIG_BT_BLE_42_FEATURES_SUPPORTED=y
```
